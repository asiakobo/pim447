## Kconfig
```kconfig
# 2024 t0bybr & asiacobo

config ZMK_PIM447
  bool "Pimoroni PIM447 Trackball support"
  select ZMK_MOUSE
  select I2C
  select GPIO
  help
    Enable driver for Pimoroni  Trackball.

if ZMK_PIM447
  config PIMORONI_PIM447_AUTOMOUSE_TIMEOUT_MS
    int "Amount of milliseconds the mouse layer will be active after using the trackball"
    default 400
  config PIMORONI_PIM447_POLLING_INTERVAL_MS
    int "Amount of miliiseconds the mouse polling interval"
    default 120
  config PIMORONI_PIM447_SCALE
    int "Amount of scaling factor"
    default 5
  config ZMK_PIM447_BEHAVIORS
    bool "Enable Pimoroni PIM447 Trackball Actions behavior"
    depends on ZMK_PIMORONI_PIM447
    select ZMK_BEHAVIORS
    default y
    help
      Enable Pimoroni PIM447 Trackball behaviors.

endif # ZMK_PIM447
```
